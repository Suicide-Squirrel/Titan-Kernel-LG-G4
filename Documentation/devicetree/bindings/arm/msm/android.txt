## Documentation/devicetree/bindings/arm/msm/android.txt
```
Android firmware

Node to specify early mount of system partition.

Required properties

-compatible: "android,firmware"

Child nodes:
------------

fstab:
------------------------------

fstab entry to specify mount attributes of system partition.

Required properties:

-compatible: "android,fstab"

Child nodes:
------------

system:
-----------------

system partition specification.

Required properties:

-compatible: "android,system"
-dev: block device corresponding to system partition
-type: file system type of system partition
-mnt_flags: mount flags
-fsmgr_flags: fsmgr flags

Example:

        firmware: firmware {
                android {
                        compatible = "android,firmware";
                        fstab {
                                compatible = "android,fstab";
                                system {
                                        compatible = "android,system";
                                        dev = "/dev/block/platform/soc.0/f9824900.sdhci/by-name/system";
                                        type = "ext4";
                                        mnt_flags = "ro,barrier=1,discard";
                                        fsmgr_flags = "wait,slotselect";
                                        status = "ok";
                                };
                        };
                };
        };
        
```

## drivers/input/touchscreen/lge/Kconfig
```kconfig
#
# LGE touch core configuration
#

if INPUT_TOUCHSCREEN

menuconfig LGE_TOUCH_CORE
	bool "LGE Touch Core - Generic"
	select LGE_TOUCH_CORE_BASE
	help
	  If your plaform is generic linux, say Y

menuconfig LGE_TOUCH_CORE_MTK
	bool "LGE Touch Core - MTK"
	select LGE_TOUCH_CORE_BASE
	help
	  If your plaform is mtk linux, say Y

config LGE_TOUCH_CORE_BASE
	bool "LGE Touch Core Base"
	depends on SPI_MASTER && I2C

config LGE_TOUCH_FW_PATH
	string "LGE Touch Core Firmware Path"
	help
	LGE_TOUCH_FW_PATH is set to path of synaptics firmware

menuconfig LGE_TOUCH_LG4945
	bool "LGE Touch Core device - LG4945"
	depends on LGE_TOUCH_CORE_BASE
	help
	  If your device is lg4945, say Y

menuconfig LGE_TOUCH_SYNAPTICS
	bool "LGE Touch Core device - Synaptics"
	depends on LGE_TOUCH_CORE_BASE
	help
	  If your device is synaptics, say Y

endif
```

## drivers/misc/itson_module1/Kconfig
```kconfig
#
# Configuration for initramfs
#

config ITSON_API
	tristate "ItsOn API Kernel module support"
	default n
	---help---
	This module adds support for ItsOn API Kernel Module.
```

## drivers/nfc/Kconfig
```kconfig
#
# Near Field Communication (NFC) devices
#

menu "Near Field Communication (NFC) devices"
	depends on NFC
endmenu

config LGE_NFC
	bool "NFC Device Enabled for LGE"
	default n

config LGE_NFC_PN547_C2
	bool "PN547 C2 NFC driver"
	depends on I2C
	select CRC_CCITT
	default n
	---help---
	  Say yes if you want PN547 Near Field Communication driver.
	  This is for i2c connected version. If unsure, say N here.

	  To compile this driver as a module, choose m here. The module will
	  be called pn547.

config NFC_BCM2079X
	bool "Broadcom 2079X NFC Controller Driver"
	depends on I2C
	select CRC_CCITT
	help
	  Broadcom 2079X Near Field Communication controller support.

config BCM2079X_MTK_PLATFORM
	bool "Broadcom Driver for MTK Platform"
	default n
	---help---
	  Say yes if it is based on MTK Platform.

config LGE_NFC_PRESTANDBY
	bool "NFC STANBY MODE"
	default n
	---help---
	  Say yes if you want to change a power state of pn544 to stanby mode in Kernel.
	  If unsure, say N here.

config LGE_NFC_MULTICORE_FASTBOOT
	bool "NFC MultiThread"
	default n
	---help---
	  Say yes if multi thread is applied for pre-standby.
	  If unsure, say N here.

config LGE_NFC_SET_IRQ_WAKEUP
	bool "NFC Set IRQ wakeup when NFC ON"
	default n
	---help---
	  Say yes if Set IRQ Wakeup NFC ON.
	  If unsure, say N here.

config LGE_NFC_DEBUG_MESSAGE
	bool "NFC Debug Message"
	default n

config LGE_NFC_USE_PMIC
	bool "NFC Using PMIC Clock"
	default n
	---help---
	  Say yes if you want to use PMIC Clock.
	  If use XTAL or unsure, say N here.
	  Please refer to [NFC-367] for more details.

config PN5XX_MTK_PLATFORM
	bool "NXP Driver for MTK Platform"
	default n
	---help---
	  Say yes if it is based on MTK Platform.

config LGE_NFC_SONY
    bool "CXD2235BGG NFC driver for kddi"
    #depends on I2C && UART
    default n
    ---help---
      Say yes if you want CDX2235AGG Near Field Communication driver.
      This is for i2c & UART connected version. If unsure, say N here.

      To compile this driver as a module, choose m here. The module will
      be called CDX2235AGG.

source "drivers/nfc/snfc/Kconfig"
```

## drivers/soc/qcom/lge/Kconfig
```kconfig
config MACH_LGE
	bool

menu "LGE Board Selection"

config MACH_MSM8992_P1
	bool "MSM8992 P1"
	depends on ARCH_MSM8992
	select MACH_LGE
	help
	  Support for the Qualcomm MSM8992 P1 device.

config MACH_MSM8992_P1_ATT_US
	bool "MSM8992 P1_ATT_US"
	depends on ARCH_MSM8992
	select MACH_LGE
	help
	  Support for the Qualcomm MSM8992 P1_ATT_US device.

config MACH_MSM8992_P1_GLOBAL_COM
	bool "MSM8992 P1_GLOBAL_COM"
	depends on ARCH_MSM8992
	select MACH_LGE
	help
	  Support for the Qualcomm MSM8992 P1_GLOBAL_COM device.

config MACH_MSM8992_P1_CN
	bool "MSM8992 P1_CN"
	depends on ARCH_MSM8992
	select MACH_LGE
	help
	  Support for the Qualcomm MSM8992 P1_CN device.

config MACH_MSM8992_P1_CMO_CN
	bool "MSM8992 P1_CMO_CN"
	depends on ARCH_MSM8992
	select MACH_LGE
	help
	  Support for the Qualcomm MSM8992 P1_CMO_CN device.

config MACH_MSM8992_P1_CTO_CN
	bool "MSM8992 P1_CTO_CN"
	depends on ARCH_MSM8992
	select MACH_LGE
	help
	  Support for the Qualcomm MSM8992 P1_CTO_CN device.

config MACH_MSM8992_P1_KR
	bool "MSM8992 P1_KR"
	depends on ARCH_MSM8992
	select MACH_LGE
	help
	  Support for the Qualcomm MSM8992 P1_KR device.

config MACH_MSM8992_P1_LGU_KR
    bool "MSM8992 P1_LGU_KR"
    depends on MACH_MSM8992_P1_KR
    help
      Support for the Qualcomm MSM8992 P1_LGU_KR device.

config MACH_MSM8992_P1_SKT_KR
    bool "MSM8992 P1_SKT_KR"
    depends on MACH_MSM8992_P1_KR
    help
      Support for the Qualcomm MSM8992 P1_SKT_KR device.

config MACH_MSM8992_P1_KT_KR
    bool "MSM8992 P1_KT_KR"
    depends on MACH_MSM8992_P1_KR
    help
      Support for the Qualcomm MSM8992 P1_KT_KR device.

config MACH_MSM8992_P1_SPR_US
	bool "MSM8992 P1_SPR_US"
	depends on ARCH_MSM8992
	select MACH_LGE
	help
	  Support for the Qualcomm MSM8992 P1_SPR_US device.

config MACH_MSM8992_P1_VZW
	bool "MSM8992 P1_VZW"
	depends on ARCH_MSM8992
	select MACH_LGE
	help
	  Support for the Qualcomm MSM8992 P1_VZW device.

config MACH_MSM8992_P1_TMO_US
	bool "MSM8992 P1_TMO_US"
	depends on ARCH_MSM8992
	select MACH_LGE
	help
	  Support for the Qualcomm MSM8992 P1_TMO_US device.

config MACH_MSM8992_P1_USC_US
	bool "MSM8992 P1_USC_US"
	depends on ARCH_MSM8992
	select MACH_LGE
	help
	  Support for the Qualcomm MSM8992 P1_USC_US device.

config MACH_MSM8992_P1_KDDI_JP
	bool "MSM8992 P1_KDDI_JP"
	depends on ARCH_MSM8992
	select MACH_LGE
	help
	  Support for the Qualcomm MSM8992 P1_KDDI_JP device.

config MACH_MSM8992_P1_CA
	bool "MSM8992 P1_CA"
	depends on ARCH_MSM8992
	select MACH_LGE
	help
	  Support for the Qualcomm MSM8992 P1_CA device.

config MACH_MSM8992_P1_BELL_CA
	bool "MSM8992 P1_BELL_CA"
	depends on MACH_MSM8992_P1_CA
	select MACH_LGE
	help
	  Support for the Qualcomm MSM8992 P1_BELL_CA device.

config MACH_MSM8992_P1_RGS_CA
	bool "MSM8992 P1_RGS_CA"
	depends on MACH_MSM8992_P1_CA
	select MACH_LGE
	help
	  Support for the Qualcomm MSM8992 P1_RGS_CA device.

config MACH_MSM8992_P1_TLS_CA
	bool "MSM8992 P1_TLS_CA"
	depends on MACH_MSM8992_P1_CA
	select MACH_LGE
	help
	  Support for the Qualcomm MSM8992 P1_TLS_CA device.

config MACH_MSM8992_P1_VTR_CA
	bool "MSM8992 P1_VTR_CA"
	depends on MACH_MSM8992_P1_CA
	select MACH_LGE
	help
	  Support for the Qualcomm MSM8992 P1_VTR_CA device.
endmenu

menu "LGE Specific Patches"

config LGE_BOOTLOADER_LOG
	tristate "Support LGE bootloader log"
	default n
	depends on MACH_LGE
	help
	  LGE bootloader log

config LGE_EARJACK_DEBUGGER
	bool "Earjack UART debugger support"
	default n
	depends on MACH_LGE
	help
	  Support earjack type UART debugger cable

config LGE_BOOTLOADER_TIME_CHECKER
    tristate "Supprt bootloader(LK, SBL) time"
    default n
    depends on MACH_LGE
    help
      Check LK, SBL booting time at
      sys/module/lge_bootloader_time_checker/parameters/lk_time
      sys/module/lge_bootloader_time_checker/parameters/sbl_time

config LGE_HANDLE_PANIC
	tristate "Support LGE Crash Handler"
	default n
	depends on MACH_LGE
	help
	  LGE Crash Handler

config LGE_PM_DEBUG
	tristate "Support LGE PM Debug Feature"
	default n
	depends on MACH_LGE
	help
	  LGE PM Debug Feature

config LGE_MISC_CHECKER
    tristate "Support LGE misc checker"
    default n
    depends on MACH_LGE
    help
      Read/Write ftm items in misc.

config LGE_PROBE_TIME_PROFILING
	bool "Support kernel driver probe time profiling"
	default n
	depends on MACH_LGE
	help
	  Support kernel driver probe time profiling.

config PRE_SELF_DIAGNOSIS
	tristate "Support LGE self diagnosis for factory"
	default n
	depends on MACH_LGE
	help
	  LGE self diagnosis

config CHECK_CPU
    tristate "Support LGE check cpu for factory"
    default n
    depends on MACH_LGE
    help
      LGE factory check cpu

config CHECK_EMMC
    tristate "Support LGE check emmc for factory"
    default n
    depends on MACH_LGE
    help
      LGE factory check emmc

config CHECK_RAM
    tristate "Support LGE check ram for factory"
    default n
    depends on MACH_LGE
    help
      LGE factory check ram

config CHECK_MATCHED
    tristate "Support LGE check matched for factory"
    default n
    depends on MACH_LGE
    help
      LGE factory check matched

config LGE_QSDL_SUPPORT
    tristate "Support for Quality Statistics Data Logging"
    default n
    depends on MACH_LGE
    help
       QSDL is a feature which notify infomation for quality statistics
       data logging of device.

endmenu

menu "LGE QFPROM Values"

config LGE_QFPROM_INTERFACE
	bool "Support qfprom interface"
	default n
	depends on MACH_LGE
	help
	  LGE QFPROM DRIVER.

config LGE_QFPROM_SECHASH
	string "Support qfprom sec hash"
	default 0x0
	depends on LGE_QFPROM_INTERFACE
	help
	  LGE QFPROM DRIVER-SEC partition's hash value.
endmenu
```

## drivers/switch/Kconfig
```kconfig
menuconfig SWITCH
	tristate "Switch class support"
	help
	  Say Y here to enable switch class support. This allows
	  monitoring switches by userspace via sysfs and uevent.

if SWITCH

config SWITCH_GPIO
	tristate "GPIO Swith support"
	depends on GPIOLIB
	help
	  Say Y here to enable GPIO based switch support.

config SWITCH_ARIZONA
	tristate "Wolfson Arizona Switch support"
	depends on MFD_ARIZONA && INPUT && SND_SOC
	help
	  Say Y here to enable support for external accessory detection
	  with Wolfson Arizona devices. These are audio CODECs with
	  advanced audio accessory detection support.

endif # SWITCH

config INPUT_IM401
	tristate "Fortemeida IM401 voice trigger IC support"
	depends on MACH_LGE
	default n
	help
	  This option enables device driver support for IM401, a voice trigger IC.

	  To compile this driver as module, choose M here: the
	  module will be called i2c_im401.
```
