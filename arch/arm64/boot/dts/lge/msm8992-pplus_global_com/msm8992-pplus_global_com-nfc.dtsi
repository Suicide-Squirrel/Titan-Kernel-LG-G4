/* Copyright (c) 2012, Code Aurora Forum. All rights reserved.
 *
 * This program is free software; you can redistribute it and/or modify
 * it under the terms of the GNU General Public License version 2 and
 * only version 2 as published by the Free Software Foundation.
 *
 * This program is distributed in the hope that it will be useful,
 * but WITHOUT ANY WARRANTY; without even the implied warranty of
 * MERCHANTABILITY or FITNESS FOR A PARTICULAR PURPOSE.  See the
 * GNU General Public License for more details.
 */

&i2c_6 {
	qcom,clk-freq-out = <400000>;
	bcm2079x@76 {
		compatible = "bcm,bcm2079x";
		status = "disable";
		reg = <0x76>;
		bcm,gpio_sda = <&msm_gpio 27 0x00>;
		bcm,gpio_scl = <&msm_gpio 28 0x00>;
		bcm,gpio_irq = <&msm_gpio 29 0x00>;
		bcm,gpio_ven = <&msm_gpio 30 0x00>;
		bcm,gpio_mode = <&msm_gpio 39 0x00>;
		interrupt-parent = <&msm_gpio>;
		interrupts = <29 0x2>;
		pinctrl-names = "nfc_active","nfc_suspend";
		pinctrl-0 = <&nfc_int_active &nfc_disable_active &nfc_wake_active>;
		pinctrl-1 = <&nfc_int_suspend &nfc_disable_suspend &nfc_wake_suspend>;
		bcm,i2c-pull-up = <1>;
	};
};
