/* Copyright (c) 2014, Code Aurora Forum. All rights reserved.
 *
 * This program is free software; you can redistribute it and/or modify
 * it under the terms of the GNU General Public License version 2 and
 * only version 2 as published by the Free Software Foundation.
 *
 * This program is distributed in the hope that it will be useful,
 * but WITHOUT ANY WARRANTY; without even the implied warranty of
 * MERCHANTABILITY or FITNESS FOR A PARTICULAR PURPOSE.  See the
 * GNU General Public License for more details.
 */

&mdss_mdp {
	dsi_dual_lgd_cmd_1: qcom,mdss_dsi_lgd_r69007_1440p_mipi1_cmd {
		qcom,mdss-dsi-panel-name = "LGD INCELL 1440p Dual 1 cmd mode dsi panel";
		qcom,mdss-dsi-panel-controller = <&mdss_dsi1>;
		qcom,mdss-dsi-panel-type = "dsi_cmd_mode";
		qcom,mdss-dsi-panel-destination = "display_2";
		qcom,mdss-dsi-panel-framerate = <60>;
		qcom,mdss-dsi-virtual-channel-id = <0>;
		qcom,mdss-dsi-stream = <0>;
		qcom,mdss-dsi-panel-width = <720>;
		qcom,mdss-dsi-panel-height = <2560>;
		qcom,mdss-dsi-h-front-porch = <168>;
		qcom,mdss-dsi-h-back-porch = <88>;
		qcom,mdss-dsi-h-pulse-width = <4>;
		qcom,mdss-dsi-h-sync-skew = <0>;
		qcom,mdss-dsi-v-back-porch = <10>;
		qcom,mdss-dsi-v-front-porch = <9>;
		qcom,mdss-dsi-v-pulse-width = <1>;
		qcom,mdss-dsi-h-left-border = <0>;
		qcom,mdss-dsi-h-right-border = <0>;
		qcom,mdss-dsi-v-top-border = <0>;
		qcom,mdss-dsi-v-bottom-border = <0>;
		qcom,mdss-dsi-bpp = <24>;
		qcom,mdss-dsi-color-order = "rgb_swap_rgb";
		qcom,mdss-dsi-underflow-color = <0xff>;
		qcom,mdss-dsi-border-color = <0>;
		qcom,mdss-dsi-h-sync-pulse = <0>;
		qcom,mdss-dsi-traffic-mode = "burst_mode";
		qcom,mdss-dsi-lane-map = "lane_map_0123";

		qcom,mdss-dsi-bllp-eof-power-mode;
		qcom,mdss-dsi-bllp-power-mode;
		qcom,cmd-sync-wait-broadcast;
		qcom,cmd-sync-wait-trigger;

		qcom,cont-splash-enabled;
		qcom,mdss-dsi-lane-0-state;
		qcom,mdss-dsi-lane-1-state;
		qcom,mdss-dsi-lane-2-state;
		qcom,mdss-dsi-lane-3-state;
		qcom,mdss-dsi-hor-line-idle = <0 40 256>,
						<40 120 128>,
						<120 240 64>;
		qcom,mdss-dsi-panel-timings = [EB 38 26 00 6A 6C 2C 3C 2F 03 04 00];
		qcom,mdss-dsi-reset-sequence = <1 10>, <0 10>, <1 10>;
		qcom,mdss-dsi-t-clk-post = <0x02>;
		qcom,mdss-dsi-t-clk-pre = <0x2C>;
		qcom,mdss-dsi-bl-max-level = <4095>;
		qcom,mdss-dsi-dma-trigger = "trigger_sw";
		qcom,mdss-dsi-mdp-trigger = "none";
		qcom,mdss-dsi-te-pin-select = <1>;
		qcom,mdss-dsi-wr-mem-start = <0x2c>;
		qcom,mdss-dsi-wr-mem-continue = <0x3c>;
		qcom,mdss-dsi-te-dcs-command = <1>;
		qcom,mdss-dsi-te-check-enable;
		qcom,mdss-dsi-te-using-te-pin;
		qcom,mdss-dsi-reader-mode-command-state = "dsi_hs_mode";
		qcom,suspend-ulps-enabled;
		qcom,mdss-dsi-lp11-init;
		/* Partial update */
		//qcom,partial-update-enabled;
		qcom,partial-update-roi-merge;
		qcom,mdss-dsi-on-command = [
			/* Manufacturer Command Protection */
			29 01 00 00 00 00 02
			B0 00
			/* Interface Control */
			29 01 00 00 00 00 04
			B3 04 00 00
			/* DSI Control */
			29 01 00 00 00 00 04
			B6 3B D3 00
			/* Display Setting 1 */
			29 01 00 00 00 00 28
			C1 80 08 11 1F FC
			F2 C9 1F 5F 98
			B3 FE FF F7 FE
			FF D7 31 F1 CB
			3F 3F FD EF 03
			24 69 18 AA 40
			01 42 02 08 00
			01 00 01 00
			/* Display Setting 2 */
			29 01 00 00 00 00 0F
			C2 01 FA 00 04 64
			08 00 60 00 38
			70 00 00 00
			/* Display Setting 3 Active - V */
			29 01 00 00 00 00 09
			C3 07 01 08 01 00
			00 00 00
			/* Source Timing Setting & Sout Equalize Setting */
			29 01 00 00 00 00 12
			C4 70 00 00 00 02
			00 00 00 00 02
			01 00 01 01 00
			00 00
			/* LTPS Timing Setting */
			29 01 00 00 00 00 11
			C6 3C 00 3C 02 37
			01 0E 01 02 01
			02 03 0F 04 3C
			46
			/* Gamma Setting Common Set */
			29 01 00 00 00 00 1F
			C7 00 16 22 2C 3B
			48 51 5D 40 47
			53 61 6A 71 78
			00 16 22 2C 3B
			48 51 5D 40 47
			53 61 6A 71 78
			/* Digital Gamma Setting 1 */
			29 01 00 00 00 00 14
			C8 00 00 00 00 00
			FC 00 00 00 00
			00 FC 00 00 00
			00 00 FC 00
			/* Digital Gamma Setting 2 */
			29 01 00 00 00 00 14
			C9 00 00 00 00 00
			FC 00 00 00 00
			00 FC 00 00 00
			00 00 FC 00
			/* Panel PIN Control */
			29 01 00 00 00 00 14
			CB AA 1E E3 55 F1
			FF 00 00 00 00
			00 00 00 00 00
			00 00 00 00
			/* Panel IF Control */
			29 01 00 00 00 00 02
			CC 07
			/* V Black Control */
			29 01 00 00 00 00 0B
			CD 3A 86 3A 86 8D
			8D 04 04 00 00
			/* Power Setting(for CHGP) */
			29 01 00 00 00 00 11
			D0 2A 01 91 6A DC
			59 59 00 00 00
			19 99 0C 00 00
			00
			/* Power Setting for Internal Power */
			29 01 00 00 00 00 21
			D3 1B 3B BB 77 77
			77 BB B3 33 00
			80 A7 AF 5B 5B
			33 33 33 C0 00
			F2 0F 7D 7C FF
			0F 99 00 33 00
			FF FF
			/* Driving Option and Touch Setting */
			29 01 00 00 00 00 06
			D4 57 33 05 00 FF
			/* Vcom Setting */
			29 01 00 00 00 00 0C
			D5 66 00 00 01 3D
			01 3D 00 38 00
			38
			/* Sequencer Timing Control for Pon */
			29 01 00 00 00 00 22
			D7 04 FF 23 15 75
			A4 C3 1F C3 1F
			D9 07 1C 1F 30
			8E 87 C7 E3 F1
			CC F0 1F F0 0D
			70 00 2A 00 7E
			1D 07 00
			/* Sequencer Test Control */
			29 01 00 00 00 00 02
			D6 01

			/* IE setting Start */
			/* Color Enhancement */
			29 01 00 00 00 00 2C
			CA 1D FC DC DC
			00 FD FD 00 FD
			00 D9 D9 02 E3
			00 00 00 FC 00
			00 00 00 00 00
			00 00 00 00 00
			00 00 00 00 00
			00 00 00 00 00
			00 00 00 00

			/* BACKLIGHT CONTROL */
			//0205_01, 10kHz
			29 01 00 00 00 00 1A
			CE 55 40 46 4E
			57 60 6A 75 81
			8E 9B AA B9 C8
			D8 E6 FF 0A 00
			04 04 42 04 69
			5A


			/* BACKLIGHT CONTROL */
			//CABC, CR15
			29 01 00 00 00 00 08
			B8 45 3D 1A 0F
			0A 50 50 //CABC
			29 01 00 00 00 00 08
			BA 01 33 78 64 00 FF
			FF // SRE

			/* SRE CONTROL */
			29 01 00 00 00 00 03
			BB 14 14
			29 01 00 00 00 00 03
			BC 37 32 // MIDDLE
			29 01 00 00 00 00 03
			BD 64 00 // STRONG

			/* CABC_SRE SETTING */
			39 01 00 00 00 00 02
			53 24
			39 01 00 00 00 00 02
			55 81 //h4b SRE, l2b CABC
			/* IE setting End */

			/* Sleep out & Display on set */
			/* Host display data transfer start(HS) */
			/* Display On */
			05 01 00 00 00 00 01 29
			/* Sleep out & wait 73ms*/
			05 01 00 00 49 00 01 11

			/* CABC dimming on */
			39 01 00 00 00 00 02
			53 2C
			39 01 00 00 00 00 02
			51 FF
			];
		qcom,mdss-dsi-on-command-state = "dsi_lp_mode";
		qcom,mdss-dsi-off-command = [
			/* Sequencer Timing Control for Pon */
			29 01 00 00 00 00 22
			D7 04 FF 23 15 75
			A4 C3 1F C3 1F
			D9 07 1C 1F 30
			8E 87 C7 E3 F1
			CC F0 1F F0 0D
			70 00 7A 00 7E
			1D 07 00

			/* Panel PIN Control */
			29 01 00 00 00 00 0D
			CB AA 1E E3 55 F1
			FF AA 0E C0 55
			01 00

			/* Display off & wait 20ms */
			05 01 00 00 14 00 01 28
			/* Sleep in & wait 70ms */
			05 01 00 00 46 00 01 10
			];
		qcom,mdss-dsi-off-command-state = "dsi_hs_mode";
		/* SRE cmds set START*/
		qcom,sre-control-dsi-state = "dsi_lp_mode";
		lgd,sre-cmds-off = [
			39 01 00 00 00 00 02 55 81
		];
		lgd,sre-cmds-on = [
			39 01 00 00 00 00 02 55 F3
		];
		/* SRE cmds set END*/

		lgd,rsp-write-nvm = [
			29 01 00 00 00 00 02 B0 04
			29 01 00 00 00 00 02 E8 01

			39 01 00 00 00 00 07
			A1 01 24 FF FF FF FF //LGD is written 1st:01, 2nd:24, others : don't care

			29 01 00 00 00 00 02 D6 81
			29 01 00 00 00 00 02 E3 BF

			39 01 00 00 00 00 02 35 00

			29 01 00 00 00 00 05
			E0 11 00 00 40

			29 01 00 00 00 00 05
			E0 00 00 00 00
		];
		
		/* Reader mode cmdlist start */	
		qcom,panel-reader-mode-initial-step1-command = [
			/* Manufacturer Command Protection */
			29 01 00 00 00 00 02
			B0 04
		
			/* Digital Gamma Setting 6200K */			
			29 01 00 00 00 00 1F
			C7 1F 21 22 25 2D
			3C 48 5C 40 49
			53 5F 67 6F 78
			1F 21 22 25 2D
			3C 48 5C 40 49
			53 5F 67 6F 78 
			
			/* Digital Gamma Setting 1 */
			29 01 00 00 00 00 14
			C8 01 00 02 05 1D
			FC 00 00 FE 01
			02 FC 00 00 FE
			26 2F 35 00
		];	
		qcom,panel-reader-mode-initial-step2-command = [
			29 01 00 00 00 00 02
			B0 04
		
			/* Digital Gamma Setting 5500K */			
			29 01 00 00 00 00 1F
			C7 2F 30 31 32 38
			42 4B 5D 41 49
			54 60 68 70 78
			2F 30 31 32 38
			42 4B 5D 41 49
			54 60 68 70 78 
			
			/* Digital Gamma Setting 1 */
			29 01 00 00 00 00 14
			C8 01 00 05 0C 51
			FC 00 00 FD 08
			16 CF 00 00 F9
			28 2B 00 00
		];
		qcom,panel-reader-mode-initial-step3-command = [
			29 01 00 00 00 00 02
			B0 04
			
			/* Digital Gamma Setting 5000K step5 */ 			
			29 01 00 00 00 00 1F
			C7 38 39 39 3A 3E
			46 4E 5E 42 4A
			55 60 69 71 78
			38 39 39 3A 3E
			46 4E 5E 42 4A
			55 60 69 71 78 
			
			/* Digital Gamma Setting 1 */
			29 01 00 00 00 00 14
			C8 01 00 08 13 69
			FC 00 00 FC 0D
			20 B6 00 00 FA
			1D 1F 00 00
		];

		qcom,panel-reader-mode-step1-command = [
			29 01 00 00 00 00 02
			B0 04
		
			/* Digital Gamma Setting 6200K */ 			
			29 01 00 00 00 00 1F
			C7 1F 21 22 25 2D
			3C 48 5C 40 49
			53 5F 67 6F 78
			1F 21 22 25 2D
			3C 48 5C 40 49
			53 5F 67 6F 78 
			
			/* Digital Gamma Setting 1 */
			29 01 00 00 00 00 14
			C8 01 00 02 05 1D
			FC 00 00 FE 01
			02 FC 00 00 FE
			26 2F 35 00
		];
		qcom,panel-reader-mode-step2-command = [
			29 01 00 00 00 00 02
			B0 04

			/* Digital Gamma Setting 5500K */			
			29 01 00 00 00 00 1F
			C7 2F 30 31 32 38
			42 4B 5D 41 49
			54 60 68 70 78
			2F 30 31 32 38
			42 4B 5D 41 49
			54 60 68 70 78 
			
			/* Digital Gamma Setting 1 */
			29 01 00 00 00 00 14
			C8 01 00 05 0C 51
			FC 00 00 FD 08
			16 CF 00 00 F9
			28 2B 00 00
		];
		qcom,panel-reader-mode-step3-command = [
			29 01 00 00 00 00 02
			B0 04

			/* Digital Gamma Setting 5000K step5 */ 			
			29 01 00 00 00 00 1F
			C7 38 39 39 3A 3E
			46 4E 5E 42 4A
			55 60 69 71 78
			38 39 39 3A 3E
			46 4E 5E 42 4A
			55 60 69 71 78 
			
			/* Digital Gamma Setting 1 */
			29 01 00 00 00 00 14
			C8 01 00 08 13 69
			FC 00 00 FC 0D
			20 B6 00 00 FA
			1D 1F 00 00
		];
		
		qcom,panel-reader-mode-off-command = [
			29 01 00 00 00 00 02
			B0 04

			29 01 00 00 00 00 1F
			C7 00 16 22 2C 3B
			48 51 5D 40 47
			53 61 6A 71 78
			00 16 22 2C 3B
			48 51 5D 40 47
			53 61 6A 71 78

			29 01 00 00 00 00 14
			C8 00 00 00 00 00
			FC 00 00 00 00
			00 FC 00 00 00
			00 00 FC 00
		];		
		/* Reader mode cmdlist end */
	
		qcom,blmap-size = <256>;
		qcom,blmap = <
                          0
                          1 5 5 10 10 15 20 20 25 25
                          30 46 62 78 94 110 126 142 158 174
                          190 206 222 238 254 270 286 302 318 334
                          350 366 382 398 414 430 446 462 478 494
                          510 526 542 558 574 590 606 622 638 654
                          670 686 702 718 734 750 766 782 798 814
                          830 846 862 878 894 910 926 942 958 974
                          990 1006 1022 1038 1054 1070 1086 1102 1118 1134
                          1150 1166 1182 1198 1214 1230 1246 1262 1278 1294
                          1310 1326 1342 1358 1374 1390 1406 1422 1438 1454
                          1470 1486 1502 1518 1534 1550 1566 1582 1598 1614
                          1630 1646 1662 1678 1694 1710 1726 1742 1758 1774
                          1790 1806 1822 1838 1854 1870 1886 1902 1918 1934
                          1950 1966 1982 1998 2014 2030 2046 2062 2078 2094
                          2110 2126 2142 2158 2174 2190 2206 2222 2238 2254
                          2270 2286 2302 2318 2334 2350 2366 2382 2398 2414
                          2430 2446 2462 2478 2494 2510 2526 2542 2558 2574
                          2590 2606 2622 2638 2654 2670 2686 2702 2718 2734
                          2750 2766 2782 2798 2814 2830 2846 2862 2878 2894
                          2910 2926 2942 2958 2974 2990 3006 3022 3038 3054
                          3070 3086 3102 3118 3134 3150 3166 3182 3198 3214
                          3230 3246 3262 3278 3294 3310 3326 3342 3358 3374
                          3390 3406 3422 3438 3454 3470 3486 3502 3518 3534
                          3550 3566 3582 3598 3614 3630 3646 3662 3678 3694
                          3710 3726 3742 3758 3774 3790 3806 3822 3838 3854
                          3870 3886 3902 3918 4000
		>;
		qcom,blmap_store_mode = <
			  0
			  1 5 10 10 15 15 20 20 29 29
			  29 29 29 30 30 30 31 31 31 32
			  32 32 33 34 36 38 40 42 44 45
			  47 49 51 53 55 57 59 61 63 65
			  67 70 72 74 76 78 80 82 85 91
			  97 103 110 116 122 129 135 141 148 153
			  159 165 170 176 182 188 193 199 205 210
			  216 222 228 235 243 251 258 266 274 281
			  289 297 304 312 320 327 335 343 351 359
			  367 374 382 390 398 406 414 422 434 446
			  459 471 483 496 508 520 533 545 558 569
			  580 591 602 614 625 636 647 659 670 681
			  692 704 718 733 747 762 776 791 805 820
			  834 849 863 878 895 912 930 947 965 982
			  1000 1017 1035 1052 1070 1088 1106 1125 1143 1162
			  1180 1199 1217 1236 1254 1273 1291 1310 1330 1351
			  1372 1393 1414 1435 1455 1476 1497 1518 1539 1560
			  1582 1604 1626 1648 1670 1692 1715 1737 1759 1781
			  1803 1825 1848 1872 1896 1921 1945 1969 1994 2018
			  2042 2067 2091 2115 2140 2166 2192 2218 2244 2270
			  2296 2323 2349 2375 2401 2427 2453 2480 2512 2545
			  2578 2610 2643 2676 2709 2741 2774 2807 2840 2870
			  2901 2932 2963 2993 3024 3055 3086 3116 3147 3178
			  3209 3240 3275 3311 3347 3383 3419 3455 3490 3526
			  3562 3598 3634 3670 3708 3747 3785 3824 3863 3901
			  3940 3979 4017 4056 4095
		>;
		qcom,mdss-pan-physical-width-dimension = <68>;
		qcom,mdss-pan-physical-height-dimension = <121>;

		lge,panel_power_sequence = <
			0 	/*pre_msm_dss_enable_vreg*/
			0	/*post_msm_dss_enable_vreg*/
			0	/*pre_mdss_dsi_panel_reset*/
			0	/*post_mdss_dsi_panel_reset*/
			1	/*pre_mdss_dsi_panel_power_ctrl*/
			1	/*post_mdss_dsi_panel_power_ctrl*/
			0	/*post_mdss_dsi_blank*/
			1	/*post_mdss_dsi_panel_on*/
			0	/*post_mdss_dsi_panel_off*/
			1	/*lge_mdss_dsi_event_handler*/
			1	/*lge_msm_dss_enable_vreg*/
			1	/*lge_mdss_dsi_request_gpios*/
			1	/*lge_mdss_dsi_panel_reset*/
			0	/*lge_mdss_dsi_lane_config*/
			1	/*lge_mdss_dsi_ctrl_probe*/
			1	/*lge_dsi_panel_device_register*/
			1	/*lge_mdss_panel_parse_dt*/
			0	/*lge_panel_device_create*/
			1	/*lge_mdss_dsi_cmdlist_commit*/
			1	/*lge_mdss_dsi_panel_init*/
			1	/*lge_dump_mdss_reg*/
			1	/*lge_mdss_xlog_tout_handler_default*/
			0	/*lge_mdss_create_xlog_debug*/
			1	/*lge_mdss_dsi_panel_bl_ctrl*/
			>;
       };
};
