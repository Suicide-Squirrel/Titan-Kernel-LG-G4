/* Copyright (c) 2014, The Linux Foundation. All rights reserved.
 *
 * This program is free software; you can redistribute it and/or modify
 * it under the terms of the GNU General Public License version 2 and
 * only version 2 as published by the Free Software Foundation.
 *
 * This program is distributed in the hope that it will be useful,
 * but WITHOUT ANY WARRANTY; without even the implied warranty of
 * MERCHANTABILITY or FITNESS FOR A PARTICULAR PURPOSE.  See the
 * GNU General Public License for more details.
 */

&i2c_5{

	lm3697@36 {
		compatible = "backlight,lm3697";
		status = "ok";
		reg = <0x36>;
		lm3697,lcd_bl_en = <&msm_gpio 62 0x00>;
		lm3697,max_current = <0x13>;
		lm3697,min_brightness = <0x01>;
		lm3697,default_brightness = <0x2E>;
		lm3697,max_brightness = <0xFF>;
		lm3697,enable_pwm = <0>;
		lm3697,blmap_size = <256>;
		lm3697,blmap = <
			0 63 63 63 63 63 63 63 63 63
			63 63 64 64 65 65 66 66 67 67
			68 68 69 69 70 72 73 74 75 77
			78 79 80 82 83 84 85 87 88 89
			90 92 93 94 96 97 98 99 101 102

			103 105 106 108 109 110 112 113 115 116
			117 118 119 120 121 122 124 125 126 127
			128 129 130 131 132 133 144 135 136 138
			139 140 141 142 143 144 145 146 146 147
			148 149 149 150 151 152 152 153 154 155

			156 157 158 159 159 160 161 162 163 164
			165 165 166 166 167 168 168 169 170 170
			171 171 172 173 173 174 175 175 176 177
			177 178 179 179 180 181 181 182 183 184
			184 185 186 187 187 188 188 189 189 190

			190 191 191 192 192 193 193 194 194 195
			195 196 196 197 198 198 199 199 200 200
			201 201 202 202 203 203 204 204 205 205
			206 206 207 207 207 208 208 209 209 210
			210 210 211 211 212 212 212 213 213 214

			214 214 215 215 215 216 216 217 217 217
			218 218 219 219 220 220 221 221 222 222
			222 223 223 224 224 224 225 225 225 226
			226 227 227 227 228 228 229 229 230 230
			230 231 231 232 232 232 233 233 233 234

			234 235 235 235 236 236>;

		lm3697,blmap_u1 = <
			0 29 29 29 29 29 29 29 29 29
			29 29 30 30 31 31 31 32 32 32
			33 33 34 34 35 36 38 39 40 41
			42 43 45 46 47 48 49 50 52 53
			54 55 57 58 59 60 61 63 64 65

			67 68 70 71 73 74 76 77 79 80
			81 82 83 84 85 86 88 89 90 91
			92 93 94 95 96 97 98 99 100 101
			102 103 104 105 106 107 108 109 110 110
			111 112 113 114 115 115 116 117 118 119

			120 121 122 123 123 124 125 126 127 128
			129 129 130 130 131 132 132 133 134 134
			135 135 136 137 137 138 139 139 140 141
			141 142 143 143 144 145 145 146 147 148
			148 149 150 151 151 152 152 153 153 154

			154 155 155 156 156 157 157 158 158 159
			159 160 160 161 161 162 162 163 163 164
			164 164 165 165 166 166 167 167 168 168
			169 169 170 170 170 171 171 172 172 173
			173 173 174 174 175 175 175 176 176 177

			177 177 178 178 178 179 179 180 180 180
			181 181 182 182 183 183 184 184 185 185
			185 186 186 187 187 187 188 188 188 189
			189 190 190 190 191 191 191 192 192 192
			193 193 193 194 194 194 195 195 195 196

			197 197 197 198 198 198>;

		lm3697,blmap_u2 = <
			0 63 63 63 63 63 63 63 63 63
			63 63 64 64 65 65 66 66 67 67
			68 68 69 69 70 72 73 74 75 77
			78 79 80 82 83 84 85 87 88 89
			90 92 93 94 96 97 98 99 101 102

			103 105 106 108 109 110 112 113 115 116
			117 118 119 120 121 122 124 125 126 127
			128 129 130 131 132 133 144 135 136 138
			139 140 141 142 143 144 145 146 146 147
			148 149 149 150 151 152 152 153 154 155

			156 157 158 159 159 160 161 162 163 164
			165 165 166 166 167 168 168 169 170 170
			171 171 172 173 173 174 175 175 176 177
			177 178 179 179 180 181 181 182 183 184
			184 185 186 187 187 188 188 189 189 190

			190 191 191 192 192 193 193 194 194 195
			195 196 196 197 198 198 199 199 200 200
			201 201 202 202 203 203 204 204 205 205
			206 206 207 207 207 208 208 209 209 210
			210 210 211 211 212 212 212 213 213 214

			214 214 215 215 215 216 216 217 217 217
			218 218 219 219 220 220 221 221 222 222
			222 223 223 224 224 224 225 225 225 226
			226 227 227 227 228 228 229 229 230 230
			230 231 231 232 232 232 233 233 233 234

			234 235 235 235 236 236>;
	};
};
